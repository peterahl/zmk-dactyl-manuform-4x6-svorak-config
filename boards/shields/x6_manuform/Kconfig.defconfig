## boards/shields/x6_manuform/Kconfig.defconfig
```kconfig
if SHIELD_X6_MANUFORM_LEFT

config ZMK_KEYBOARD_NAME
    default "4x6_manuform"

config ZMK_SPLIT_ROLE_CENTRAL
    default y

endif # SHIELD_X6_MANUFORM_LEFT

if SHIELD_X6_MANUFORM_LEFT || SHIELD_X6_MANUFORM_RIGHT

config ZMK_SPLIT
    default y

endif # SHIELD_X6_MANUFORM_LEFT || SHIELD_X6_MANUFORM_RIGHT
```

## boards/shields/x6_manuform/Kconfig.shield
```kconfig
config SHIELD_X6_MANUFORM_LEFT
    def_bool $(shields_list_contains,x6_manuform_left)

config SHIELD_X6_MANUFORM_RIGHT
    def_bool $(shields_list_contains,x6_manuform_right)
```
